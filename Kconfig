## Kconfig
```kconfig
# Shared code that temporarily takes the LEDs over from the underglow.
config ZMK_LED_TAKEOVER
    bool

config ZMK_BATTERY_LED_INDICATOR
    bool "Show battery level on the RGB underglow LEDs"
    default y
    depends on ZMK_RGB_UNDERGLOW && ZMK_BATTERY_REPORTING
    select ZMK_LED_TAKEOVER

if ZMK_BATTERY_LED_INDICATOR

config ZMK_BATTERY_LED_DURATION_MS
    int "How long the battery level is shown after &bat_ind is pressed"
    default 3000

config ZMK_BATTERY_LED_BRIGHTNESS
    int "Indicator brightness in percent (0 = follow the underglow brightness)"
    range 0 100
    default 0

config ZMK_BATTERY_LED_LEVEL_HIGH
    int "Battery level above which the indicator is green"
    default 60

config ZMK_BATTERY_LED_LEVEL_LOW
    int "Battery level above which the indicator is yellow (red at or below)"
    default 30

config ZMK_BATTERY_LED_WARN_LEVEL
    int "Blink red when the battery drops to this level (0 disables)"
    range 0 100
    default 15

config ZMK_BATTERY_LED_WARN_STEP
    int "Repeat the low battery warning every N percent of further discharge"
    range 1 100
    default 5

config ZMK_BATTERY_LED_WARN_BLINKS
    int "Number of blinks in the low battery warning"
    default 3

config ZMK_BATTERY_LED_TEST_STEP_MS
    int "&bat_test: time per percent of simulated discharge"
    default 100

endif

config ZMK_LED_STRIP_INDICATORS
    bool "Caps Lock indicator LED on top of the RGB underglow"
    default y
    depends on DT_HAS_ZMK_LED_STRIP_INDICATORS_ENABLED && ZMK_RGB_UNDERGLOW
    select ZMK_HID_INDICATORS

if ZMK_LED_STRIP_INDICATORS

config ZMK_CAPS_LOCK_LED_BRIGHTNESS
    int "Caps Lock LED brightness in percent (0 = follow the underglow brightness)"
    range 0 100
    default 0

endif

config ZMK_LED_SCAN
    bool "&led_scan: light the LEDs one by one to find their order in the chain"
    default y
    depends on DT_HAS_ZMK_BEHAVIOR_LED_SCAN_ENABLED && ZMK_RGB_UNDERGLOW
    select ZMK_LED_TAKEOVER

if ZMK_LED_SCAN

config ZMK_LED_SCAN_DELAY_MS
    int "How long each LED is lit"
    default 500

endif
```

## dts/bindings/behaviors/zmk,behavior-battery-indicator.yaml
```yaml
description: Show the battery level of each half on its RGB underglow LEDs

compatible: "zmk,behavior-battery-indicator"

include: zero_param.yaml
```

## dts/bindings/behaviors/zmk,behavior-battery-test.yaml
```yaml
description: Play the battery level indicator from 100% down to 0%

compatible: "zmk,behavior-battery-test"

include: zero_param.yaml
```

## dts/bindings/behaviors/zmk,behavior-led-scan.yaml
```yaml
description: Light the LEDs of a half one by one to find their order in the chain

compatible: "zmk,behavior-led-scan"

include: zero_param.yaml
```

## dts/bindings/zmk,led-display-order.yaml
```yaml
description: |
  Order in which indicators fill the LEDs of the underglow strip. Each entry is an LED index
  in the chain; the first entry lights up first.

compatible: "zmk,led-display-order"

properties:
  order:
    type: array
    required: true
```

## dts/bindings/zmk,led-strip-indicators.yaml
```yaml
description: |
  LED strip proxy that passes the underglow frames through to the real strip and lights
  an indicator LED (Caps Lock) on top of them. Point the zmk,underglow chosen node at it.

compatible: "zmk,led-strip-indicators"

include: base.yaml

properties:
  led-strip:
    type: phandle
    required: true
    description: The real LED strip.
  chain-length:
    type: int
    required: true
    description: Number of LEDs, must match the real strip.
  caps-lock-led:
    type: int
    required: true
    description: Index of the LED in the chain that shows Caps Lock.
  caps-lock-color:
    type: array
    default: [255, 255, 255]
    description: Caps Lock color as <R G B> at full brightness, scaled by the brightness setting.
```
